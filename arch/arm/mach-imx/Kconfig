## arch/arm/mach-imx/Kconfig
```kconfig
menu "IMX Implementations"
	depends on FAMILY_IMX

choice
	prompt "Select IMX-based board"
	default ARCH_MX1ADS

config ARCH_MX1ADS
	bool "mx1ads"
	depends on FAMILY_IMX
	select ARCH_IMX
	select ISA
	help
	  Say Y here if you are using the Motorola MX1ADS board

config MACH_CSB535
	bool "Cogent CSB535FS board"
	depends on FAMILY_IMX
	select ARCH_IMX21
	help
	  Say Y here if you are using the Cogent CSB535 board.

config MACH_MX21ADS
	bool "Freescale MX21 ADS board"
	depends on FAMILY_IMX
	select ARCH_IMX21
	help
	  Say Y here if you are using the Freescale MX21 ADS board.

config MACH_TCMX21
	bool "Turbochef i.MX21 board"
	depends on FAMILY_IMX
	select ARCH_IMX21
	help
	  Say Y here if you are using the Turbochef i.MX21 board.

config MACH_CSB536
	bool "Cogent CSB536FS board"
	depends on FAMILY_IMX
	select ARCH_IMX
	help
	  Say Y here if you are using the Cogent CSB536FS board.
endchoice


endmenu

config ARCH_IMX
	bool
config ARCH_IMX21
	bool
```

## sound/arm/Kconfig
```kconfig
# ALSA ARM drivers

menu "ALSA ARM devices"
	depends on SND!=n && ARM

config SND_SA11XX_UDA1341
	tristate "SA11xx UDA1341TS driver (iPaq H3600)"
	depends on ARCH_SA1100 && SND && L3
	select SND_PCM
	help
	  Say Y here if you have a Compaq iPaq H3x00 handheld computer
	  and want to use its Philips UDA 1341 audio chip.

	  To compile this driver as a module, choose M here: the module
	  will be called snd-sa11xx-uda1341.

config SND_ARMAACI
	tristate "ARM PrimeCell PL041 AC Link support"
	depends on SND && ARM_AMBA
	select SND_PCM
	select SND_AC97_CODEC

config SND_PXA2XX_PCM
	tristate
	select SND_PCM

config SND_PXA2XX_AC97
	tristate "AC97 driver for the Intel PXA2xx chip"
	depends on ARCH_PXA && SND
	select SND_PXA2XX_PCM
	select SND_AC97_CODEC
	help
	  Say Y or M if you want to support any AC97 codec attached to
	  the PXA2xx AC97 interface.

config SND_IMX21_WM8731
	tristate "IMX21 audio driver, WM8731 CODEC"
	depends on (MACH_MX21ADS || MACH_TCMX21 || MACH_CSB535) && SND
	select I2C
	select I2C_IMX
	select SND_PCM
	help
	  ALSA Sound driver for IMX21 boards with a WM8731 CODEC.

endmenu
```
